## config/boards/shields/cornedeon_2mod/Kconfig.defconfig
```kconfig
if SHIELD_CORNEDEON_2MOD_LEFT

config ZMK_KEYBOARD_NAME
    default "Cornedeon 2M"

config ZMK_SPLIT_ROLE_CENTRAL
    default y

config ZMK_USB
    default y

endif

if SHIELD_CORNEDEON_2MOD_LEFT || SHIELD_CORNEDEON_2MOD_RIGHT

config ZMK_SPLIT
    default y

endif
```

## config/boards/shields/cornedeon_2mod/Kconfig.shield
```kconfig
# Copyright (c) 2020 Pete Johanson
# SPDX-License-Identifier: MIT

config SHIELD_CORNEDEON_2MOD_LEFT
    def_bool $(shields_list_contains,cornedeon_2mod_left)

config SHIELD_CORNEDEON_2MOD_RIGHT
    def_bool $(shields_list_contains,cornedeon_2mod_right)
```
