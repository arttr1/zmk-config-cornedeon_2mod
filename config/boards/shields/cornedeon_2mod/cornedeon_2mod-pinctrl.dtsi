#include <dt-bindings/pinctrl/rpi-pico-rp2040-pinctrl.h>

&pinctrl {
    /* uart0 default state: GP0 = TX, GP1 = RX (matches the QMK
     * SERIAL_USART_TX_PIN/RX_PIN wiring used for the TRRS/USB-C link
     * between the two halves). */
    uart0_default: uart0_default {
        group1 {
            pinmux = <UART0_TX_P0>;
        };
        group2 {
            pinmux = <UART0_RX_P1>;
            input-enable;
        };
    };
};
